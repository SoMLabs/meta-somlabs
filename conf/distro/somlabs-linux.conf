## conf/distro/somlabs-linux.conf
```bitbake
require conf/distro/poky.conf

DISTRO = "somlabs-linux"
DISTROOVERRIDES = "poky"
DISTRO_NAME = "SomLabs-Linux (SomLabs Reference Distro)"
DISTRO_VERSION = "1.0"

#Features we do not like to have
DISTRO_FEATURES_remove = "x11 wayland 3g phone alsa"
DISTRO_FEATURES_append = " bluez5 bluetooth wifi"

#Use systemd exclusively
DISTRO_FEATURES_append = " systemd"
VIRTUAL-RUNTIME_init_manager = "systemd"
VIRTUAL-RUNTIME_dev_manager = "systemd"

#Prevent the SysVinit distribution feature from being automatically enabled
DISTRO_FEATURES_BACKFILL_CONSIDERED = "sysvinit"

#Remove any redundant SysVinit scripts
VIRTUAL-RUNTIME_initscripts = ""

#Licenses for firmware etc.
LICENSE_FLAGS_WHITELIST = "commercial"
```

## conf/machine/visionsom6ull-nand256.conf
```bitbake
#@TYPE: Machine
#@NAME: SoMLabs i.MX6ULL VisionSOM-6ULL, NAND 256MB version
#@SOC: i.MX6ULL
#@DESCRIPTION: Machine configuration for VisionSOM-6ULL
#@MAINTAINER: Michal Wolowik <michwolo@gmail.com>

MACHINEOVERRIDES =. "mx6:mx6ull:use-mainline-bsp:mx6ull"

include conf/machine/include/imx-base.inc
include conf/machine/include/tune-cortexa7.inc

KERNEL_DEVICETREE = "\
  somlabs-visionsom-6ull-nand.dtb \
"
UBOOT_CONFIG ??= "nand"
UBOOT_CONFIG[nand] = "somlabs_visionsom_6ull_nand_defconfig"

PREFERRED_PROVIDER_u-boot = "u-boot-somlabs"
PREFERRED_PROVIDER_virtual/bootloader = "u-boot-somlabs"
PREFERRED_PROVIDER_virtual/kernel = "linux-fslc"

SERIAL_CONSOLE = "115200 ttymxc0"

MACHINE_FEATURES += "wifi bluetooth"

IMAGE_FSTYPES += "tar.bz2 ubifs ubi tar.xz"

#NAND - 256MB
UBI_VOLNAME = "rootfs"
MKUBIFS_ARGS = "-F -m 2048 -e 126976 -c 5600"
UBINIZE_ARGS = "-m 2048 -p 128KiB -s 512 -O 2048"

#Firmware for Murata Wi-Fi module
MACHINE_EXTRA_RRECOMMENDS += "firmware-imx-brcm"
```

## conf/machine/visionsom6ull-nand512.conf
```bitbake
#@TYPE: Machine
#@NAME: SoMLabs i.MX6ULL VisionSOM-6ULL, NAND 512MB version
#@SOC: i.MX6ULL
#@DESCRIPTION: Machine configuration for VisionSOM-6ULL
#@MAINTAINER: Michal Wolowik <michwolo@gmail.com>

MACHINEOVERRIDES =. "mx6:mx6ull:use-mainline-bsp:"

include conf/machine/include/imx-base.inc
include conf/machine/include/tune-cortexa7.inc

KERNEL_DEVICETREE = "\
  somlabs-visionsom-6ull-nand.dtb \
"
UBOOT_CONFIG ??= "nand"
UBOOT_CONFIG[nand] = "somlabs_visionsom_6ull_nand_defconfig"

PREFERRED_PROVIDER_u-boot = "u-boot-somlabs"
PREFERRED_PROVIDER_virtual/bootloader = "u-boot-somlabs"
PREFERRED_PROVIDER_virtual/kernel = "linux-fslc"

SERIAL_CONSOLE = "115200 ttymxc0"

MACHINE_FEATURES += "wifi bluetooth"

IMAGE_FSTYPES += "tar.bz2 ubifs ubi tar.xz"

#NAND - 512MB
UBI_VOLNAME = "rootfs"
MKUBIFS_ARGS = "-F -m 4096 -e 253952 -c 2650"
UBINIZE_ARGS = "-m 4096 -p 256KiB -s 4096 -O 4096"

#Firmware for Murata Wi-Fi module
MACHINE_EXTRA_RRECOMMENDS += "firmware-imx-brcm"
```

## conf/machine/visionsom6ull.conf
```bitbake
#@TYPE: Machine
#@NAME: SoMLabs i.MX6ULL VisionSOM-6ULL
#@SOC: i.MX6ULL
#@DESCRIPTION: Machine configuration for VisionSOM-6ULL
#@MAINTAINER: Marcin Bis <marcin@bis-linux.com>

MACHINEOVERRIDES =. "mx6:mx6ull:use-mainline-bsp:"

include conf/machine/include/imx-base.inc
include conf/machine/include/tune-cortexa7.inc

KERNEL_DEVICETREE = "\
  somlabs-visionsom-6ul.dtb \
  somlabs-visionsom-6ul-emmc.dtb \
  somlabs-visionsom-6ul-nand.dtb \
  somlabs-visionsom-6ull.dtb \
  somlabs-visionsom-6ull-emmc.dtb \
  somlabs-visionsom-6ull-nand.dtb \
"

UBOOT_CONFIG ??= "sd"
UBOOT_CONFIG[sd] = "somlabs_visionsom_6ull_config"

PREFERRED_PROVIDER_u-boot = "u-boot-somlabs"
PREFERRED_PROVIDER_virtual/bootloader = "u-boot-somlabs"
PREFERRED_PROVIDER_virtual/kernel = "linux-fslc"

SERIAL_CONSOLE = "115200 ttymxc0"

MACHINE_FEATURES += "wifi bluetooth"

#Single partition on SD card.
WKS_FILE = "imx-uboot.wks"

#Firmware for Murata Wi-Fi module
MACHINE_EXTRA_RRECOMMENDS += "firmware-imx-brcm"
```
